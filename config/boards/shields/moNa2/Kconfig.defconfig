## config/boards/shields/moNa2/Kconfig.defconfig
```kconfig
if SHIELD_MOGA_R

config ZMK_KEYBOARD_NAME
    default "moGa_R"

config ZMK_SPLIT
    default y

config ZMK_SPLIT_ROLE_CENTRAL
    default y

endif

if SHIELD_MOGA_L

config ZMK_KEYBOARD_NAME
    default "moGa_L"

config ZMK_SPLIT
    default y

endif
```

## config/boards/shields/moNa2/Kconfig.shield
```kconfig
config SHIELD_MOGA_R
    def_bool $(shields_list_contains,moGa_R)

config SHIELD_MOGA_L
    def_bool $(shields_list_contains,moGa_L)
```
